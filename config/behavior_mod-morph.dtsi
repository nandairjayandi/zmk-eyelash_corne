#include <behaviors.dtsi>
#include "zmk-helpers/helper.h"

#define SIMPLE_MORPH(NAME, MOD, BINDING1, BINDING2) ZMK_MOD_MORPH(NAME, mods = <(MOD_L##MOD | MOD_R##MOD)>; bindings = <BINDING1>, <BINDING2>;)

SIMPLE_MORPH(morph_comma,   SFT,    &kp COMMA,      &kp QMARK)      // ,?
SIMPLE_MORPH(morph_dot,     SFT,    &kp DOT,        &kp EXCL)       // .!
SIMPLE_MORPH(morph_sqt,     SFT,    &kp SQT,        &kp UNDER)      // '_
SIMPLE_MORPH(morph_min,     SFT,    &kp MINUS,      &kp DQT)        // -"

// NUMBER layer morph
SIMPLE_MORPH(morph_dot2,    SFT,    &kp KP_DOT,     &kp KP_COMMA)   // ., Keypad Version
SIMPLE_MORPH(morph_fslh,    SFT,    &kp FSLH,       &kp PRCNT)      // /%
SIMPLE_MORPH(morph_eql,     SFT,    &kp KP_EQUAL,   &kp BSLH)       // =\
SIMPLE_MORPH(morph_star,    SFT,    &kp STAR,       &kp CARET)      // *^

SIMPLE_MORPH(morph_and,     SFT,    &kp AMPS,       &kp AT)         // &@
SIMPLE_MORPH(morph_hash,    SFT,    &kp HASH,       &kp DLLR)       // #$

SIMPLE_MORPH(morph_bral,    SFT,    &tap_bral_one,  &tap_bral_two)  // ([ {<
SIMPLE_MORPH(morph_brar,    SFT,    &tap_brar_one,  &tap_brar_two)  // )] }>

SIMPLE_MORPH(morph_bspc,    SFT,    &kp BSPC,       &kp DELETE)     // BSPC DEL // NOTE see adv_layers.dtsi for 
SIMPLE_MORPH(morph_spc,     SFT,    &kp SPC,        &kp INSERT)     // SPC INS