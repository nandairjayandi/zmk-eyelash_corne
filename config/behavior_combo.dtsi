#include <behaviors.dtsi>
#include "zmk-helpers/helper.h"

#include "behavior_mod-morph.dtsi"
#include "adv_layers.dtsi"

#define COMBO_TERM_FAST 18
#define COMBO_TERM_SLOW 50

#define COMBO_IDLE_FAST 150
#define COMBO_IDLE_SLOW 30

/*                42 KEY MATRIX with ENCODER and JOYSTICK / LAYOUT MAPPING
  ╭────────────────────────╮             ╭────╮      ╭─────────────────────────╮
  │  0   1   2   3   4   5 │         ╭───╯  6 ╰───╮  │   7   8   9  10  11  12 │
  │ 13  14  15  16  17  18 │ ╭────╮  │ 19  20  21 │  │  22  23  24  25  26  27 │
  │ 28  29  30  31  32  33 │ │ 34 │  ╰───╮ 35 ╭───╯  │  36  37  38  39  40  41 │
  ╰───────────╮ 42  43  44 │ ╰────╯      ╰────╯      │  45  46  47 ╭───────────╯
              ╰────────────╯                         ╰─────────────╯

  ╭──────────────────────────────╮              ╭─────╮      ╭──────────────────────────────╮
  │ LT5  LT4  LT3  LT2  LT1  LT0 │          ╭───╯ JS0 ╰───╮  │ RT0  RT1  RT2  RT3  RT4  RT5 │
  │ LM5  LM4  LM3  LM2  LM1  LM0 │ ╭─────╮  │ JS1 JS2 JS3 │  │ RM0  RM1  RM2  RM3  RM4  RM5 │
  │ LB5  LB4  LB3  LB2  LB1  LB0 │ │ LEC │  ╰───╮ JS4 ╭───╯  │ RB0  RB1  RB2  RB3  RB4  RB5 │
  ╰──────────────╮ LH2  LH1  LH0 │ ╰─────╯      ╰─────╯      │ RH0  RH1  RH2 ╭──────────────╯
                 ╰───────────────╯                           ╰───────────────╯

*/

/*        name,                   keycode,            button,     layer,      timeout(30),  prior-idle */
ZMK_COMBO (com_semi,              &kp SEMI,           RB2 RB3,    0,          45)
ZMK_COMBO (com_and,               &morph_and,         LB2 LB3,    0,          45)

// Num Layer Combo          
ZMK_COMBO (com_bral,              &morph_bral,        LM2 LM3,    1)
ZMK_COMBO (com_brar,              &morph_brar,        LM1 LM2,    1)

ZMK_COMBO (com_capsword,          &caps_word,         LH1 RH1,    0,          60)
ZMK_COMBO (com_esc,               &kp ESC,            LH0 RH0,    0 1 2,      80)

// macOS Specific   
/* Most of my hotkeys is managed through BetterTouchTool and takes advantage of Super(Meta Alt Control)/Hyper(Super + Shift) Key */ 
ZMK_COMBO (com_undo,              &kp LG(Z),          LB1 LB2,    0) 
ZMK_COMBO (com_redo,              &kp LG(LS(Z)),      RB1 RB2,    0) 

ZMK_COMBO (com_char,              &kp LG(LS(SPACE)),  LT5 RT5,    0) // Character (Emoji Symbol) Selector 
ZMK_COMBO (com_menu,              &kp LG(LS(FSLH)),   RB1 RB3,    2) // Open Menu Bar Search Menu

// VIM Navigation
MAKE_HT   (ht_kp, &kp, &kp)
ZMK_COMBO (com_vim_word_left,     &ht_kp  HOME B,     RM1 RM2,    2) // Tap to jump one word left Hold to jump to start
ZMK_COMBO (com_vim_word_right,    &ht_kp  END E,      RM2 RM3,    2) // Tap to jump one word right Hold to jump to end

// Layer Navigation Combo   
ZMK_COMBO (combo_sys,             &tog 4,             LB5 RB5,    0)
ZMK_COMBO (combo_fn,              &tog 3,             LM5 RM5,    0)
ZMK_COMBO (combo_home_layer,      &to 0,              LH2 RH2,    1 2 3 4)
ZMK_COMBO (combo_number,          &tog 1,             LM5 LH1)
ZMK_COMBO (combo_nav,             &tog 2,             RM5 RH1)