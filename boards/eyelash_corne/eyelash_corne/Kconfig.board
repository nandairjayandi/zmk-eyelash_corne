## boards/eyelash_corne/eyelash_corne/Kconfig.board
```kconfig
#
# Copyright (c) 2024 The ZMK Contributors
# SPDX-License-Identifier: MIT
#

config BOARD_EYELASH_CORNE_LEFT
    depends on SOC_NRF52840_QIAA

config BOARD_EYELASH_CORNE_RIGHT
    depends on SOC_NRF52840_QIAA
```

## boards/eyelash_corne/eyelash_corne/Kconfig.eyelash_corne
```kconfig
#
# Copyright (c) 2024 The ZMK Contributors
# SPDX-License-Identifier: MIT
#

# https://zmk.dev/blog/2025/12/09/zephyr-4-1#adjust-kconfig-files
config BOARD_EYELASH_CORNE_LEFT
    select SOC_NRF52840_QIAA

config BOARD_EYELASH_CORNE_RIGHT
    select SOC_NRF52840_QIAA
```

## boards/eyelash_corne/eyelash_corne/board.yml
```yaml
boards:
  - name: eyelash_corne_left
    vendor: eyelash_corne
    socs:
      - name: nrf52840
        variants:
          - name: zmk
  - name: eyelash_corne_right
    vendor: eyelash_corne
    socs:
      - name: nrf52840
        variants:
          - name: zmk
```

## config/west.yml
```yaml
manifest:
  remotes:
    - name: zmkfirmware
      url-base: https://github.com/zmkfirmware
    - name: nandairjayandi
      url-base: https://github.com/nandairjayandi
    - name: m165437
      url-base: https://github.com/M165437
    - name: urob
      url-base: https://github.com/urob

  projects:
    - name: zmk
      remote: zmkfirmware
      revision: v0.3.0
      import: app/west.yml
    - name: nice-view-gem 
      remote: m165437 
      revision: v0.3.0
    - name: zmk-helpers
      remote: urob
      revision: v0.3.0
    - name: zmk-behavior-dynamic-macros
      remote: nandairjayandi # from bsalex
      revision: main
    - name: zmk-auto-layer
      remote: urob
      revision: v0.3

  self:
    path: config
```
